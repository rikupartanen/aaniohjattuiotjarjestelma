## CMakeLists.txt
```
cmake_minimum_required(VERSION 3.20.0)
find_package(Zephyr REQUIRED HINTS $ENV{ZEPHYR_BASE})

project(c-thingy-model)
target_sources(app PRIVATE 
  src/main.c 
  src/qspi/qspi.s 
  src/qspi/qspi.c
)

zephyr_library_named(model)
zephyr_library_sources(
  src/common.c 
  src/model.c
  src/layers/conv1.c 
  src/layers/dense.c
  src/layers/toinenkonvoluutio.c
  src/layers/maxpooling2d.c
  src/layers/normalisaatio.c
  src/layers/resizing.c
  src/weights_map.c
)
zephyr_library_include_directories(include)

zephyr_library_named(fftr)
zephyr_library_sources(libs/libFFTr/FFTr.c)

zephyr_library_named(ffti)
zephyr_library_sources(libs/libFFTi/FFTi.c)

target_link_libraries(app PUBLIC model ffti)
target_include_directories(app PRIVATE libs/libFFTr libs/libFFTi)
```

## prj.conf
```kconfig
CONFIG_CBPRINTF_FP_SUPPORT=y
CONFIG_FPU=y
CONFIG_SERIAL=y

CONFIG_BOOT_BANNER=n

# Add QSPI drivers
CONFIG_NORDIC_QSPI_NOR=y
CONFIG_FLASH=y
CONFIG_NRFX_QSPI=y
CONFIG_XIP=y
CONFIG_NORDIC_QSPI_NOR_XIP=y

CONFIG_MAIN_STACK_SIZE=64000
```

## src/main.c
```c
//  based on dense implementation
#include <stdio.h>
#include <stdlib.h>
#include <string.h>
#include <time.h>

#include "common.h"
#include "layers/conv1.h"
#include "layers/dense.h"
#include "layers/toinenkonvoluutio.h"
#include "FFTi.h"
#include "model.h"
#include "sample.h"
#include "qspi/qspi.h"

#define PRINT_ARR(arr, size, header)             \
  puts(header);                                  \
  for (size_t i = 0; i < size; i++) {            \
    if (i % 5 == 0 && i != 0) printf("\n");      \
    else if (i != 0) printf(" ");                \
    char str[8];                                 \
    snprintf(str, 8, "% .4f", (double)(arr)[i]); \
    printf("%s", str);                           \
  }                                              \
  printf("\n")

#define TENSOR_P(name, vec, shape) struct tensor *name = create_tensor(vec, shape);
#define ARR_CAST(dst, src, to, len)  \
  for (size_t i = 0; i < len; i++) { \
    (dst)[i] = (to)(src)[i];         \
  }

#define SPEC_SIZE 124 * 129
int main() {
  printf("Hello World\n");
  qspi_init();
  // PRINT_ARR(sample, 16000, "Sample:");
  float *spec = malloc(16000 * sizeof(float));
  FFTi(sample, (float(*)[])spec);

  // float *spec_f = malloc(16000 * sizeof(float));
  // ARR_CAST(spec_f, spec, float, SPEC_SIZE);
  // free(spec);

  // clang-format off
  // TENSOR(input, VEC(
  //     DIM(.1f, .2f, .3f, .4f, .5f, .6f),
  //     DIM(.6f, .5f, .4f, .3f, .2f, .1f),
  //     DIM(.1f, .2f, .3f, .4f, .5f, .6f),
  //     DIM(.6f, .5f, .4f, .3f, .2f, .1f),
  //     DIM(.1f, .2f, .3f, .4f, .5f, .6f),
  //     DIM(.6f, .5f, .4f, .3f, .2f, .1f)
  // ), SHAPE(1, 6, 6, 1));
  struct tensor *input;
  {
    input = malloc(sizeof(struct tensor));
    input->vec = spec;
    input->shape = malloc(3 * sizeof(size_t));

    input->shape[0] = 129;
    input->shape[1] = 124;
    input->shape[2] = 0;
  }
  // clang-format on

  struct tensor *out = model(input);
  if (!out) return -1;
  
  printf("OUT\n");
  _print_tensor(out);
  print_shape(out);

  free_tensor(out);

  if (!out) return -1;
  return 0;
}
```

## include/weights_map.h
```c
#ifndef REALWEIGHTS_H__
#define REALWEIGHTS_H__
#include <stddef.h>
#define FLASH_BASE 0x10000000

#define normalization_kweights ((float*)(FLASH_BASE + 0))
extern const float *normalization_bweights;
extern const size_t normalization_kshape[];
extern const size_t normalization_bshape[];

extern const float *conv2d_kweights;
extern const float *conv2d_bweights;
extern const size_t conv2d_kshape[];
extern const size_t conv2d_bshape[];

#define conv2d_1_kweights ((float*)(FLASH_BASE + 0x50c))
#define conv2d_1_bweights ((float*)(FLASH_BASE + 0x1250c))
extern const size_t conv2d_1_kshape[];
extern const size_t conv2d_1_bshape[];

extern const float *dense_kweights;
extern const float *dense_bweights;
extern const size_t dense_kshape[];
extern const size_t dense_bshape[];

extern const float *dense_1_kweights;
extern const float *dense_1_bweights;
extern const size_t dense_1_kshape[];
extern const size_t dense_1_bshape[];

#endif /* REALWEIGHTS_H__ */
```

## src/common.c
```c
#include "common.h"

// Return the lenght of shape list
inline size_t get_shape_len(size_t *shape) {
  size_t len;
  for (len = 0; shape[len]; len++) {}
  return len;
}

/**
 * @brief Return geometric sum from start to len - end
 *
 * @param vec values to sum
 * @param len lenght of input
 * @param start start index
 * @param end end index as `len - end`
 */
inline size_t geometric_sum(size_t *vec, size_t len, size_t start, size_t end) {
  size_t r_len = 1;
  for (size_t i = start; i < len - end; i++) {
    r_len *= vec[i];
  }
  return r_len;
}

// Create tensor in heap memory
struct tensor *create_tensor(float *vec, size_t *shape) {
  struct tensor *l = malloc(sizeof(struct tensor));
  size_t shape_len = get_shape_len(shape);
  size_t vec_len = geometric_sum(shape, shape_len, 0, 0);

  shape_len++;
  l->_static = false;
  l->vec = malloc(vec_len * sizeof(float));
  l->shape = malloc(shape_len * sizeof(size_t));
  memmove(l->vec, vec, vec_len * sizeof(float));
  memmove(l->shape, shape, shape_len * sizeof(size_t));

  return l;
}

// Create static tensor in heap memory
const struct tensor *create_static_tensor(const float *vec, const size_t *shape) {
  struct tensor *l = malloc(sizeof(struct tensor));
  l->_static = true;
  l->vec = (float *)vec;
  l->shape = (size_t *)shape;

  return l;
}

// Free heap tensor
void free_tensor(const struct tensor *tensor) {
  if (tensor) {
    if (tensor->_static) {
      free((void *)tensor);
    } else {
      free((void *)tensor->vec);
      free((void *)tensor->shape);
      free((void *)tensor);
    }
  }
}

// Set a new shape for the tensor
extern inline void reshape(struct tensor *tensor, size_t *new_shape);

void print_shape(const struct tensor *out) {
  printf("Shape: ");
  for (size_t i = 0; out->shape[i]; i++) {
    if (i % 5 == 0 && i != 0) printf("\n");
    else if (i != 0) printf(" ");
    printf("%zu", out->shape[i]);
  }
  printf("\n");
}

void _print_tensor(const struct tensor *out) {
  size_t len = get_shape_len(out->shape);
  if (len < 1) return;
  size_t x = len > 2 ? out->shape[len - 2] : 1;
  size_t y = out->shape[len - 1];
  len = geometric_sum(out->shape, len, 0, 0);
  for (size_t i = 0; i < len; i++) {
    if (i != 0) {
      if (i % (y * x) == 0 && x != 1) printf("\n\n");
      else if (i % y == 0) printf("\n");
      else printf(" ");
    }
    printf("%f", out->vec[i]);
  }
  printf("\n");
}
```

## src/common.h
```c
#ifndef COMMON_H
#define COMMON_H

#include <stdio.h>
#include <stdlib.h>
#include <string.h>
#include <stdbool.h>

// Create shape array
#define SHAPE(...) \
  { __VA_ARGS__, 0 }
// Create vector array
#define VEC(...) \
  { __VA_ARGS__ }
// Noop, used for readability
#define DIM(...) __VA_ARGS__
// Helper for creating tensors
#define TENSOR(name, vec, shape) \
  struct tensor *name;           \
  do {                           \
    float v[] = vec;             \
    size_t s[] = shape;          \
    name = create_tensor(v, s);  \
  } while (0)

struct tensor {
  bool _static;
  float *vec;
  size_t *shape;
};

size_t get_shape_len(size_t *shape);
size_t geometric_sum(size_t *vec, size_t len, size_t start, size_t end);
struct tensor *create_tensor(float *vec, size_t *shape);
const struct tensor *create_static_tensor(const float *vec, const size_t *shape);
void free_tensor(const struct tensor *tensor);

inline void reshape(struct tensor *tensor, size_t *new_shape) {
  const size_t len = get_shape_len(new_shape);
  free(tensor->shape);
  tensor->shape = malloc((len + 1) * sizeof(size_t));
  memmove(tensor->shape, new_shape, (len + 1) * sizeof(size_t));
}

void print_shape(const struct tensor *out);
void _print_tensor(const struct tensor *out);

#endif
```

## src/model.c
```c
#include "common.h"
#include "layers/conv1.h"
#include "layers/dense.h"
#include "layers/maxpooling2d.h"
#include "layers/normalisaatio.h"
#include "layers/resizing.h"
#include "layers/toinenkonvoluutio.h"
#include "weights_map.h"

struct tensor *model(struct tensor *input) {
  struct tensor *tmp;
  struct tensor *out;

  float *ret = malloc(32 * 32 * sizeof(float));
  resizing((float(*)[])input->vec, (float(*)[])ret);
  free_tensor(input);
  normalisaatio((float(*)[])ret);
  {
    out = malloc(sizeof(struct tensor));
    out->vec = ret;
    out->shape = malloc(4 * sizeof(size_t));

    out->shape[0] = 1;
    out->shape[1] = 32;
    out->shape[2] = 32;
    out->shape[3] = 0;
  }

  // clang-format off
  // TENSOR(conv2d_kernel, VEC(
  //     DIM(1.f, 1.f, 1.f),
  //     DIM(2.f, 0.f, 2.f),
  //     DIM(3.f, 3.f, 3.f),
  // ), SHAPE(1, 3, 3));
  // TENSOR(conv2d_bias, VEC(DIM(0.f)), SHAPE(1, 1, 1));
  // clang-format on

  puts("Conv2d");
  // size_t shape[] = SHAPE(32, 3, 3);
  const struct tensor *conv2d_kernel = create_static_tensor(conv2d_kweights, conv2d_kshape);
  const struct tensor *conv2d_bias = create_static_tensor(conv2d_bweights, conv2d_bshape);
  tmp = conv2d1(out, conv2d_kernel, conv2d_bias);
  free_tensor(out);
  out = tmp;
  free_tensor(conv2d_kernel);
  free_tensor(conv2d_bias);

  puts("Conv2d 2");
  ret = calloc(OUT_IMAGES * OUT_SIZE_Y * OUT_SIZE_X, sizeof(float));
  toinenkonvoluutio((float(*)[IMAGE_SIZE_Y][IMAGE_SIZE_X])out->vec, (float(*)[OUT_SIZE_Y][OUT_SIZE_X])ret);
  free_tensor(out);

  // const struct tensor *conv2d_1_kernel = create_static_tensor(conv2d_1_kweights, conv2d_1_kshape);
  // const struct tensor *conv2d_1_bias = create_static_tensor(conv2d_1_bweights, conv2d_1_bshape);
  // tmp = conv2d1(out, conv2d_1_kernel, conv2d_1_bias);
  // free_tensor(out);
  // out = tmp;
  // free_tensor(conv2d_kernel);
  // free_tensor(conv2d_bias);

  // Initialize dense kernel
  // clang-format off
  // TENSOR(dense_kernel, VEC(
  //     DIM(1, 1, 2, 2),
  //     DIM(1, 1, .5, .5),
  //     DIM(1, 1, 2, 2),
  //     DIM(1, 1, .5, .5)
  // ), SHAPE(2 * 2, 4));
  // clang-format on

  puts("Maxpooling");
  {
    out = malloc(sizeof(struct tensor));
    out->vec = calloc(12544, sizeof(float));
    out->shape = malloc(3 * sizeof(size_t));

    out->shape[0] = 1;
    out->shape[1] = 12544;
    out->shape[2] = 0;
  }
  maxpooling2d(ret, 1, 64, 28, 28, 2, 2, 2, 2, out->vec);

  // size_t new_shape[] = SHAPE(1, 12544);
  // reshape(out, new_shape);
  // puts("Reshaped out:");
  // print_shape(out);

  puts("Dense");
  const struct tensor *dense_kernel = create_static_tensor(dense_kweights, dense_kshape);
  const struct tensor *dense_bias = create_static_tensor(dense_bweights, dense_bshape);
  tmp = dense(out, dense_kernel, dense_bias);
  free_tensor(out);
  out = tmp;

  free_tensor(dense_kernel);
  free_tensor(dense_bias);

  puts("Dense 2");
  const struct tensor *dense_1_kernel = create_static_tensor(dense_1_kweights, dense_1_kshape);
  const struct tensor *dense_1_bias = create_static_tensor(dense_1_bweights, dense_1_bshape);
  tmp = dense(out, dense_1_kernel, dense_1_bias);
  free_tensor(out);
  out = tmp;
  free_tensor(dense_1_kernel);
  free_tensor(dense_1_bias);

  puts("\nModel fin:");
  return out;
}
```
