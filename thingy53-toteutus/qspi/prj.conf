## CMakeLists.txt
```
# SPDX-License-Identifier: Apache-2.0

cmake_minimum_required(VERSION 3.20.0)

find_package(Zephyr REQUIRED HINTS $ENV{ZEPHYR_BASE})
project(hello_world)

FILE(GLOB app_sources src/*.c src/*.s)
target_sources(app PRIVATE ${app_sources})

# Code relocation
#zephyr_code_relocate(FILES src/data.s LOCATION EXTFLASH_TEXT_DATA_BSS NOCOPY)
```

## prj.conf
```kconfig
CONFIG_NORDIC_QSPI_NOR=y
CONFIG_FLASH=y
CONFIG_NRFX_QSPI=y
CONFIG_XIP=y
CONFIG_NORDIC_QSPI_NOR_XIP=y
CONFIG_BOOT_BANNER=n

CONFIG_SERIAL=y
```

## src/main.c
```c
#include <stdio.h>
#include <zephyr/kernel.h>
#include <zephyr/drivers/flash.h>
#include <stdint.h>
#include <zephyr/devicetree.h>
#include <zephyr/device.h>
#include <nrfx_qspi.h>
#include <zephyr/drivers/uart.h>
#include <stdlib.h>

#include "qspi.h"

#define UART_ACK        0x6
#define UART_NAK        0x15

#define UART_BAUD       115200

/* File transfer commands */
#define PROT_WSTART     0x80
#define PROT_WSTOP      0x90
#define PROT_WRITE      0xA0
#define PROT_SEEK       0


#define EXTFLASH_SIZE 0x800000
#define WORDSIZE 4
#define IS_ALIGNED(x) (!(x % WORDSIZE))

enum state{
    STATE_IDLE,
    STATE_WRITE,
    STATE_ERASE,
    STATE_READ
};


/* Pointer will keep track of where we are writing in memory */
static uint32_t g_writeptr = 0x0;

const struct device *uart_dev = DEVICE_DT_GET(DT_NODELABEL(cdc_acm_uart));

static inline void uart_send_ack(){
    uart_poll_out(uart_dev, UART_ACK);
}

static inline void uart_send_nak(){
    uart_poll_out(uart_dev, UART_NAK);
}

static inline void uart_print(char *s){
    for(; *s; s++){
        uart_poll_out(uart_dev, *s);
    }
}

void dummy_write(uint32_t *tx_buff, size_t tx_len, uint32_t dst){
/*    for(int i = 0; i < tx_len / sizeof(uint32_t); ++i){
        test[i] = tx_buff[i];
    }
    return;*/

    qspi_write(tx_buff, tx_len, dst);
}

int write_mode(){
    uart_send_ack();
    char tmp = 0;
    uint8_t len = 0;
    uint8_t rx_buff[128] = {0};

    while((uart_poll_in(uart_dev, &tmp)) != 0);

    /* See if write length is in an acceptable range (0-127)
     * NOTE: this may be changed to check for a crc enable given with data len */
    if(tmp > 0x7F){
        uart_send_nak();
        return -1;
    }

    uart_send_ack();

    /* lengths of 0 are not a thing, 
     * assume write always wants to write at least 1 byte */
    len = tmp + 1;

    for(uint8_t i = 0; i < len; ++i){
        while((uart_poll_in(uart_dev, &rx_buff[i]) != 0));
    }

    /* Make sure our len is actually word-aligned 
     * and round up if required 
     * transmitter side should have already sorted this */
    len = (len + (WORDSIZE - 1)) & -WORDSIZE;

    /* We can use malloc() here since we're always copying a multiple of 4 bytes
     * from rx_buff which has been initialized to 0 */
    uint32_t *tx_buff = malloc(len);
    memcpy(tx_buff, rx_buff, len);
    dummy_write(tx_buff, len, g_writeptr);

    free(tx_buff);

    g_writeptr += len;

    uart_send_ack();
    return 0;
}

/* These 2 are a bit unnecessary, but in case
 * any functionality past an ACK is needed, they're here */
static inline void wstart(){
    uart_send_ack();
}

static inline void wstop(){
    uart_send_ack();
}


int main(void){	
    qspi_init();
//    qspi_erase(0x0, ERASE_ALL);
    static enum state state = STATE_IDLE;
    char input = 0;

    const struct uart_config uart_cfg = {
        .baudrate = UART_BAUD,
        .parity = UART_CFG_PARITY_NONE,
        .stop_bits = UART_CFG_STOP_BITS_1,
        .data_bits = UART_CFG_DATA_BITS_8,
        .flow_ctrl = UART_CFG_FLOW_CTRL_RTS_CTS,
    };

    uart_configure(uart_dev, &uart_cfg);

    while(1){
        input = 0;
        while((uart_poll_in(uart_dev, &input)) != 0);

        switch(input){
            case PROT_WSTART:
                state = STATE_WRITE;
                wstart();
                break;
            case PROT_WSTOP:
                state = STATE_IDLE;
                wstop();
                break;
            case PROT_WRITE:
                if(state == STATE_WRITE){
                    int ret = write_mode(); 
                    /* go back to idle if write fails */
                    if(ret != 0)
                        state = STATE_IDLE;
                }
                break;
        }

    }

    return 0;
}
```

## src/qspi.c
```c
#include <zephyr/kernel.h>
#include <zephyr/drivers/flash.h>
#include <stdint.h>
#include <nrfx_qspi.h>

#include "qspi.h"

#define EXTFLASH_SIZE 0x800000
#define WORDSIZE 4

/* gcc optimizes this to a tst instruction 
 * so use modulo because it's a little bit clearer */
#define IS_ALIGNED(x) ( !(x % WORDSIZE) )


/* Assembly functions */
extern void _qspi_configure(void);
extern void _qspi_activate(void);
extern void _qspi_deactivate(void);
extern void _qspi_write(uint32_t *tx_buff, size_t tx_len, uint32_t dst);
extern void _qspi_read(uint32_t *rx_buff, size_t rx_len, uint32_t src);
extern void _qspi_erase(uint32_t start, enum erase_len len);
extern uint32_t _qspi_status();


/* Checks ready bit, must be done before read/write/erase operations */
static inline void qspi_wait_ready(){
    while(_qspi_status() & 0x4);
}


int qspi_read(uint32_t *rx_buff, size_t rx_len, uint32_t src){
    /* Both rx_len and src need to be word-aligned */
    if(!IS_ALIGNED(rx_len) || !IS_ALIGNED(src)){
        return -1;
    }

    /* Make sure read doesn't start at the end of flash
     * and that read wouldn't run past the end of flash */
    if(src >= EXTFLASH_SIZE || (src + rx_len) > EXTFLASH_SIZE){
        return -2;
    }

    qspi_wait_ready();
    _qspi_read(rx_buff, rx_len, src);
    return 0;
}

int qspi_write(uint32_t *tx_buff, size_t tx_len, uint32_t dst){
    /* Both tx_len and dst need to be word-aligned */
    if(!IS_ALIGNED(tx_len) || !IS_ALIGNED(dst)){
        return -1;
    }

    /* Make sure write doesn't start at the end of flash
     * and that write wouldn't run past the end of flash */
    if(dst >= EXTFLASH_SIZE || (dst + tx_len) > EXTFLASH_SIZE){
        return -2;
    }

    qspi_wait_ready();
    _qspi_write(tx_buff, tx_len, dst);
    return 0;
}


int qspi_erase(uint32_t start, enum erase_len len){
    if(!IS_ALIGNED(start)){
        return -1;
    }

    qspi_wait_ready();
    _qspi_erase(start, len);
    return 0;
}

/* Deactivate qspi peripheral */
void qspi_deactivate(){
    _qspi_deactivate();
}


/* Configure and activate QSPI peripheral */
void qspi_init(){
    _qspi_configure();
    _qspi_activate();
}
```

## src/qspi.h
```c
#ifndef QSPI_H__
#define QSPI_H__

enum erase_len{
    ERASE_4KB   = 0,
    ERASE_64KB  = 1,
    ERASE_ALL   = 2
};

/* @brief Read from location in flash.
 *
 * @param *rx_buff  Pointer to allocated buffer where data read will be stored.
 * @param rx_len    Length of buffer in bytes. Must be a multiple of wordsize.
 * @param src       Word-aligned source address to start read from.
 * @return          0 on success, -1 if rx_len or src are not word-aligned,
 *                  -2 if `src` is at or past the end of memory, or if read would
 *                  run past the end of flash.
 *                 
 * @note Will block until QSPI peripheral is ready to read.
 */
int qspi_read(uint32_t *rx_buff, size_t rx_len, uint32_t src);

/* @brief Write to location in flash.
 * 
 * @param *tx_buff  Pointer to buffer containing data that will be written.
 * @param tx_len    Length of buffer in bytes. Must be a multiple of wordsize.
 * @param dst       Word-aligned destination address to start write at.
 * @return          0 on success, -1 if tx_len is not a multiple of wordsize, 
 *                  -2 if `dst` is at or past the end of memory, or if read would
 *                  run past the end of flash.
 *                  
 * @note Will block until QSPI peripheral is ready to read.
 */
int qspi_write(uint32_t *tx_buff, size_t tx_len, uint32_t dst);

/* @brief Erase page in flash.
 *
 * @param start     Word-aligned address to start erasing from.
 * @param len       How much to erase, can be one of ERASE_4KB, ERASE_64KB or ERASE_ALL.
 * @return          0 on success, -1 if `start` is not a word-aligned address.
 *
 * @note Will block until QSPI peripheral is ready to erase.
 * @note Does not currently provide any way to check when erasing is done.
 */
int qspi_erase(uint32_t start, enum erase_len len);


/* @brief Configure and activate QSPI peripheral 
 * @note Currently there is no way to change the configuration,
 *       this simply functions as a wrapper for some asm procedures. */
void qspi_init(void);

/* @brief Deactivate QSPI peripheral.
 * @note This is only really useful 
 *       if power consumption has to be minimized. */
void qspi_deactivate(void);


#endif /* QSPI_H__ */
```
